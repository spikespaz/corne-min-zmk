/* Maximum milliseconds between releasing one key and pressing the next, at your natural
 * typing cadence. Keystrokes arriving within this interval perpetuate a typing streak that
 * suppresses hold behaviors; a key arriving after it becomes eligible to trigger one.
 */
#ifndef TYPING_CADENCE
#define TYPING_CADENCE    150
#endif

/* How long a typing streak persists after the last key — home-row presses within this
 * interval are considered taps. Equal to TYPING_CADENCE: one keystroke's worth of idle
 * time is enough to clear it.
 */
#ifndef TYPING_STREAK_GRACE
#define TYPING_STREAK_GRACE    TYPING_CADENCE
#endif

/* Extra hold duration beyond TYPING_CADENCE before each finger's modifier fires.
 * Outer fingers use higher values to reduce accidental holds from imprecise presses.
 */
#ifndef HOME_PINKY_HOLD_LAG
#define HOME_PINKY_HOLD_LAG    120
#endif
#ifndef HOME_RINGY_HOLD_LAG
#define HOME_RINGY_HOLD_LAG     90
#endif
#ifndef HOME_MIDDY_HOLD_LAG
#define HOME_MIDDY_HOLD_LAG     60
#endif
#ifndef HOME_INDEX_HOLD_LAG
#define HOME_INDEX_HOLD_LAG     30
#endif

/* By how many milliseconds per-finger to shorten TYPING_STREAK_GRACE, causing
 * its hold action to become eligible before the typing streak has timed out.
 */
#ifndef HOME_PINKY_HOLD_LEAD
#define HOME_PINKY_HOLD_LEAD     0
#endif
#ifndef HOME_RINGY_HOLD_LEAD
#define HOME_RINGY_HOLD_LEAD     0
#endif
#ifndef HOME_MIDDY_HOLD_LEAD
#define HOME_MIDDY_HOLD_LEAD     0
#endif
#ifndef HOME_INDEX_HOLD_LEAD
#define HOME_INDEX_HOLD_LEAD    80
#endif

/* How readily each finger commits to its modifier when held. "tap-preferred" requires
 * holding that long regardless; "balanced" also fires the moment another key is pressed
 * and released while held, without needing to reach that duration.
 */
#ifndef HOME_PINKY_HOLD_KIND
#define HOME_PINKY_HOLD_KIND    "tap-preferred"
#endif
#ifndef HOME_RINGY_HOLD_KIND
#define HOME_RINGY_HOLD_KIND    "tap-preferred"
#endif
#ifndef HOME_MIDDY_HOLD_KIND
#define HOME_MIDDY_HOLD_KIND    "tap-preferred"
#endif
#ifndef HOME_INDEX_HOLD_KIND
#define HOME_INDEX_HOLD_KIND    "tap-preferred"
#endif

/* Which modifier each finger fires when held, as a "left, right" pair.
 */
#ifndef HOME_PINKY_HOLD_MOD
#define HOME_PINKY_HOLD_MOD    LGUI, RGUI
#endif
#ifndef HOME_RINGY_HOLD_MOD
#define HOME_RINGY_HOLD_MOD    LALT, RALT
#endif
#ifndef HOME_MIDDY_HOLD_MOD
#define HOME_MIDDY_HOLD_MOD    LCTL, RCTL
#endif
#ifndef HOME_INDEX_HOLD_MOD
#define HOME_INDEX_HOLD_MOD    LSFT, RSFT
#endif

/* Extend the grace period beyond TYPING_CADENCE after a tap, during which releasing
 * and then holding the same key again produces repeat events rather than the modifier.
 */
#ifndef HOME_KEY_REPEAT_GRACE
#define HOME_KEY_REPEAT_GRACE    150
#endif

/* Activate the SHIFT modifier the moment its key is pressed down, without waiting
 * for its release within the tapping term. If released in time to be considered a tap,
 * the modifier key is released and tap behavior triggers.
 */
#ifndef HOME_INSTANT_SHIFT
#define HOME_INSTANT_SHIFT    0
#endif


/* Each home key is a 2-cell hold-tap: <hold-mod> <tap-key>. Per-finger timing
 * is determined by the parameters defined above; the third argument is the opposite
 * hand's key positions, so a hold only triggers across hands.
 */
#define ZMK_HRM(name, finger, triggers, ...) \
    / { behaviors { name: name { \
        compatible = "zmk,behavior-hold-tap"; \
        #binding-cells = <2>; \
        bindings = <&kp>, <&kp>; \
        flavor = HOME_##finger##_HOLD_KIND; \
        quick-tap-ms = <(TYPING_CADENCE + HOME_KEY_REPEAT_GRACE)>; \
        tapping-term-ms = <(TYPING_CADENCE + HOME_##finger##_HOLD_LAG)>; \
        require-prior-idle-ms = <(TYPING_STREAK_GRACE - HOME_##finger##_HOLD_LEAD)>; \
        hold-trigger-key-positions = <triggers>; \
        hold-trigger-on-release; \
        __VA_ARGS__ }; }; };

/* Select the left or right member of an "L, R" tuple.
 */
#define HRM_FST(a, b)    a
#define HRM_SND(a, b)    b
#define HRM_L(tuple)     HRM_FST(tuple)
#define HRM_R(tuple)     HRM_SND(tuple)

ZMK_HRM(lhp, PINKY, KEYS_R)
ZMK_HRM(lhr, RINGY, KEYS_R)
ZMK_HRM(lhm, MIDDY, KEYS_R)
ZMK_HRM(lhi, INDEX, KEYS_R)
ZMK_HRM(rhi, INDEX, KEYS_L)
ZMK_HRM(rhm, MIDDY, KEYS_L)
ZMK_HRM(rhr, RINGY, KEYS_L)
ZMK_HRM(rhp, PINKY, KEYS_L)

#define lhp(tap)    lhp  HRM_L(HOME_PINKY_HOLD_MOD)  tap
#define lhr(tap)    lhr  HRM_L(HOME_RINGY_HOLD_MOD)  tap
#define lhm(tap)    lhm  HRM_L(HOME_MIDDY_HOLD_MOD)  tap
#define lhi(tap)    lhi  HRM_L(HOME_INDEX_HOLD_MOD)  tap
#define rhi(tap)    rhi  HRM_R(HOME_INDEX_HOLD_MOD)  tap
#define rhm(tap)    rhm  HRM_R(HOME_MIDDY_HOLD_MOD)  tap
#define rhr(tap)    rhr  HRM_R(HOME_RINGY_HOLD_MOD)  tap
#define rhp(tap)    rhp  HRM_R(HOME_PINKY_HOLD_MOD)  tap

#if HOME_INSTANT_SHIFT
&lhi { hold-while-undecided; };
&rhi { hold-while-undecided; };
#endif
