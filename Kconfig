## Kconfig
```kconfig
config ZMK_BEHAVIOR_USB_TOGGLE
    bool
    default y
    depends on DT_HAS_ZMK_BEHAVIOR_USB_TOGGLE_ENABLED
    depends on ZMK_BLE
    depends on !ZMK_SPLIT || ZMK_SPLIT_ROLE_CENTRAL
```

## config/west.yml
```yaml
manifest:
  remotes:
    - name: zmkfirmware
      url-base: https://github.com/zmkfirmware
    # Additional modules containing boards/shields/custom code can be listed here as well
    # See https://docs.zephyrproject.org/3.2.0/develop/west/manifest.html#projects
  projects:
    - name: zmk
      remote: zmkfirmware
      revision: v0.3
      import: app/west.yml
    - name: corne-min-rgbled
      url: https://github.com/MechboardsLTD/zmk-module
      revision: corne-min-rgbled
    - name: corne-min-board
      url: https://github.com/MechboardsLTD/zmk-module
      revision: corne-min
    - name: prospector-module
      url: https://github.com/MechboardsLTD/zmk-module
      revision: prospector
    - name: zmk-helpers
      url: https://github.com/urob/zmk-helpers
      path: modules/zmk/helpers
      revision: 0b9e9d1dd9e86f70b4c8c2b0fab55c4f90c9d2e3

  self:
    path: config
```

## dts/bindings/behaviors/zmk,behavior-usb-toggle.yaml
```yaml
# Copyright (c) 2026 Jacob Birkett
# SPDX-License-Identifier: MIT

description: Output toggle that won't store BLE until BLE can take over

compatible: "zmk,behavior-usb-toggle"

include: zero_param.yaml
```
